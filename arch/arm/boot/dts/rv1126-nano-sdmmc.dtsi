// SPDX-License-Identifier: (GPL-2.0+ OR MIT)
/*
 * Guangzhou Easy EAI Technology Co., Ltd.
 *
 */

&sdmmc {
	bus-width = <4>;
	cap-mmc-highspeed;
	cap-sd-highspeed;
	card-detect-delay = <200>;
	rockchip,default-sample-phase = <90>;
	supports-sd;
	sd-uhs-sdr12;
	sd-uhs-sdr25;
	sd-uhs-sdr104;
	vqmmc-supply = <&vccio_sd>;
	vmmc-supply = <&vcc3v3_sd>;
	status = "okay";
};
