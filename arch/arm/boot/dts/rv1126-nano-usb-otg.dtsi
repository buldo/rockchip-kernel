// SPDX-License-Identifier: (GPL-2.0+ OR MIT)
/*
 * Copyright (c) 2024 Guangzhou EASY EAI Technology Co., Ltd.
 */

&u2phy0 {
	status = "okay";
	//vup-gpios = <&gpio0 RK_PC1 GPIO_ACTIVE_LOW>;
	u2phy_otg: otg-port {
		status = "okay";
	};
};

&usbdrd {
	status = "okay";
};

&usbdrd_dwc3 {
	status = "okay";
	extcon = <&u2phy0>;
};