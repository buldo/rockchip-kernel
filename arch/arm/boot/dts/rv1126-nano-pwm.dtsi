// SPDX-License-Identifier: (GPL-2.0+ OR MIT)
/*
 * Guangzhou Easy EAI Technology Co., Ltd.
 *
 */

&pwm9 {
	pinctrl-0 = <&pwm9m1_pins>;
	status = "okay";
};

&pwm10 {
	pinctrl-0 = <&pwm10m1_pins>;
	status = "okay";
};
